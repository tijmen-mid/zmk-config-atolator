#include <dt-bindings/zmk/matrix_transform.h>

/ {
    chosen {
        zmk,kscan = &kscan0;
        zmk,matrix_transform = &default_transform;
    };

    /* 5x12 row-major matrix transform: logical positions 0..59 */
    default_transform: keymap_transform_0 {
        compatible = "zmk,matrix-transform";
        columns = <12>;
        rows = <5>;
        map = <
            MATRIX_TRANSFORM_ROW(  0,  1,  2,  3,  4,  5,  6,  7,  8,  9, 10, 11 )
            MATRIX_TRANSFORM_ROW( 12, 13, 14, 15, 16, 17, 18, 19, 20, 21, 22, 23 )
            MATRIX_TRANSFORM_ROW( 24, 25, 26, 27, 28, 29, 30, 31, 32, 33, 34, 35 )
            MATRIX_TRANSFORM_ROW( 36, 37, 38, 39, 40, 41, 42, 43, 44, 45, 46, 47 )
            MATRIX_TRANSFORM_ROW( 48, 49, 50, 51, 52, 53, 54, 55, 56, 57, 58, 59 )
        >;
    };

    kscan0: kscan {
        compatible = "zmk,kscan-gpio-matrix";
        wakeup-source;
        diode-direction = "col2row";
        row-gpios = <
            &pro_micro 21 (GPIO_ACTIVE_HIGH | GPIO_PULL_DOWN) /* Row A */
            &pro_micro 20 (GPIO_ACTIVE_HIGH | GPIO_PULL_DOWN) /* Row B */
            &pro_micro 19 (GPIO_ACTIVE_HIGH | GPIO_PULL_DOWN) /* Row C */
            &pro_micro 18 (GPIO_ACTIVE_HIGH | GPIO_PULL_DOWN) /* Row D */
            &pro_micro 15 (GPIO_ACTIVE_HIGH | GPIO_PULL_DOWN) /* Row E */
        >;
    };
};
