## boards/shields/Kconfig.defconfig
```kconfig
if SHIELD_atolator_LEFT

config ZMK_KEYBOARD_NAME
    default "atolator"

config ZMK_SPLIT_ROLE_CENTRAL
    default y

endif

if SHIELD_atolator_LEFT || SHIELD_atolator_RIGHT

config ZMK_SPLIT
    default y

endif
```

## boards/shields/Kconfig.shield
```kconfig
config SHIELD_atolator_LEFT
    def_bool $(shields_list_contains,atolator_left)

config SHIELD_atolator_RIGHT
    def_bool $(shields_list_contains,atolator_right)
```
